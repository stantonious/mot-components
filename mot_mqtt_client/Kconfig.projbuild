## mot_mqtt_client/Kconfig.projbuild
```kconfig
menu "MOT MQTT Config"

    config MOT_CLIENT_ID
        string "MOT Client ID"
        default "mot0"
        help
            The unique ID for this MOT client

endmenu
```
